## yocto/layers/meta-mcs/conf/distro/mcs-linux.conf
```bitbake
DISTRO = "mcs-linux"
DISTRO_NAME = "MCS Linux"
DISTRO_VERSION = "1.0"

TCLIBC = "glibc"
INIT_MANAGER = "systemd"
DISTRO_FEATURES:remove = "x11 wayland vulkan opengl pulseaudio alsa bluetooth 3g pcmcia ptest"
```
